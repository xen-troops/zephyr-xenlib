## CMakeLists.txt
```
# SPDX-License-Identifier: Apache-2.0

cmake_minimum_required(VERSION 3.20.0)
find_package(Zephyr REQUIRED HINTS $ENV{ZEPHYR_BASE})
project(test_xrun)

target_include_directories(app PRIVATE ${APPLICATION_SOURCE_DIR}/../../xrun/include/
${APPLICATION_SOURCE_DIR}/include)

FILE(GLOB app_sources src/main.c src/mock-storage.c src/mock-xen-dom-mgmt.c src/mock-parser.c)
target_sources(app PRIVATE ${app_sources} ../../xrun/src/xrun.c)
zephyr_include_directories(include)
```

## Kconfig
```
# Copyright (C) 2023 Renesas Electronics Corporation.
# Copyright (C) 2023 EPAM Systems, Inc.
#
# SPDX-License-Identifier: Apache-2.0

mainmenu "Xrun test application"

config XRUN_JSON_SIZE_MAX
	int "Maximum size of the json cni spec"
	default 8192
	help
	  Sets the maximum size of the cni spec json that could
	  be passed to xrun call.

config XRUN_MAX_PATH_SIZE
	int "Maximum length of file path to read from storage"
	default 255
	help
	  Sets the maximum path size that xrun can read from storage.
	  The default value is set to LFS_NAME_MAX which is default
	  for littlefs configuration.

config PARTIAL_DEVICE_TREE_SIZE
	int "Domain device tree size"
	default 8192
	help
	  Maximum size of the domain device tree

source "Kconfig"
```

## prj.conf
```kconfig
# Enable test suit

CONFIG_ZTEST=y
CONFIG_ZTEST_NEW_API=y

# Enable debug for tests

CONFIG_DEBUG=y

CONFIG_XRUN_JSON_SIZE_MAX=8192
CONFIG_PARTIAL_DEVICE_TREE_SIZE=8192
CONFIG_XRUN_MAX_PATH_SIZE=255
CONFIG_JSON_LIBRARY=y

CONFIG_HEAP_MEM_POOL_SIZE=2097152
```

## src/main.c
```c
/*
 * Copyright (C) 2023 Renesas Electronics Corporation.
 * Copyright (C) 2023 EPAM Systems, Inc.
 *
 * SPDX-License-Identifier: Apache-2.0
 */

#include <domain.h>
#include <string.h>
#include <zephyr/types.h>
#include <stdbool.h>
#include <zephyr/ztest.h>
#include <zephyr/data/json.h>

#include <xrun.h>
char *test_json_contents;
char *test_dtb_contents;
char *test_image_name;
char *test_dtb_name;
struct xen_domain_cfg g_cfg;

ZTEST(lib_xrun_test, test_json_spec_def)
{
	char json[] = "{"
		"\"ociVersion\" : \"1.0.1\", "
		"\"vm\" : { "
		"\"hypervisor\": { "
		"\"path\": \"xen\", "
		"\"parameters\": [\"pvcalls=true\"] "
		"}, "
		"\"kernel\": { "
		"\"path\" : \"/lfs/unikernel.bin\", "
		"\"parameters\" : [ \"port=8124\", \"hello world\" ]"
		"}, "
		"\"hwConfig\": { "
		"\"deviceTree\": \"/lfs/uni.dtb\", "
		"\"vcpus\": 2, "
		"\"memKB\": 4097, "
		"\"dtdevs\": [ \"dev1\", \"dev2\" ], "
		"\"iomems\": [ "
		"{ \"firstGFN\": 40000, "
		"\"firstMFN\": 40002, "
		"\"nrMFNs\": 1 }, "
		"{ \"firstGFN\": 50000, "
		"\"firstMFN\": 50002, "
		"\"nrMFNs\": 2 } "
		"], "
		"\"irqs\": [ 1, 2 ] "
		"} "
		"} "
		"}";

	int ret;
	uint32_t val;

	test_json_contents = json;
	test_dtb_contents = "dtb";
	test_dtb_name = "uni.dtb";
	test_image_name = "unikernel.bin";

	ret = xrun_run("/test", 0, "test");
	zassert_equal(ret, 0, "Error calling xrun_run");

	zassert_equal(g_cfg.mem_kb, 4097, "mem_kb wasn't decoded correctly");
	zassert_equal(g_cfg.max_vcpus, 2, "max_vcpus wasn't decoded correctly");

	zassert_equal(g_cfg.nr_dtdevs, 2,
		      "dtdevs wasn't decoded correctly");

	zassert_true(!strcmp(g_cfg.dtdevs[0], "dev1"),
		     "Dtdevs not decoded correctly");
	zassert_true(!strcmp(g_cfg.dtdevs[1], "dev2"),
		     "Dtdevs not decoded correctly");

	zassert_equal(g_cfg.nr_irqs, 2,
		      "nr_irqs wasn't decoded correctly");
	zassert_equal(g_cfg.irqs[0], 1, "irqs wasn't decoded correctly");
	zassert_equal(g_cfg.irqs[1], 2, "irqs wasn't decoded correctly");

	zassert_equal(g_cfg.nr_iomems, 2,
		      "nr_iomems wasn't decoded correctly");

	val = g_cfg.iomems[0].first_gfn;
	zassert_equal(val, 40000, "iomems wasn't decoded correctly");

	val = g_cfg.iomems[0].first_mfn;
	zassert_equal(val, 40002, "iomems wasn't decoded correctly");

	val = g_cfg.iomems[0].nr_mfns;
	zassert_equal(val, 1, "iomems wasn't decoded correctly");

	val = g_cfg.iomems[1].first_gfn;
	zassert_equal(val, 50000, "iomems wasn't decoded correctly");

	val = g_cfg.iomems[1].first_mfn;
	zassert_equal(val, 50002,
		      "iomems wasn't decoded correctly Got:%u",
		      val);

	val = g_cfg.iomems[1].nr_mfns;
	zassert_equal(val, 2,
		      "iomems wasn't decoded correctly Got:%u",
		      val);

	zassert_true(!strcmp(g_cfg.dtb_start, test_dtb_contents),
		     "Dtb file not decoded correctly");

	zassert_true(!strcmp(g_cfg.cmdline, "port=8124 hello world"),
		     "Dtb file not decoded correctly");

	ret = xrun_kill("test");
	zassert_equal(ret, 0, "Error calling xrun_run");
}

ZTEST(lib_xrun_test, test_json_spec_no_cmdline)
{
	char json[] = "{"
		"\"ociVersion\" : \"1.0.1\", "
		"\"vm\" : { "
		"\"hypervisor\": { "
		"\"path\": \"xen\", "
		"\"parameters\": [\"pvcalls=true\"] "
		"}, "
		"\"kernel\": { "
		"\"path\" : \"/lfs/unikernel.bin\", "
		"\"parameters\" : []"
		"}, "
		"\"hwConfig\": { "
		"\"deviceTree\": \"/lfs/uni.dtb\", "
		"\"vcpus\": 1, "
		"\"memKB\": 4096, "
		"\"dtdevs\": [ \"dev1\", \"dev2\" ], "
		"\"iomems\": [ "
		"{ \"firstGFN\": 40000, "
		"\"firstMFN\": 40002, "
		"\"nrMFNs\": 1 }, "
		"{ \"firstGFN\": 50000, "
		"\"firstMFN\": 50002, "
		"\"nrMFNs\": 2 } "
		"], "
		"\"irqs\": [ 1, 2 ] "
		"} "
		"} "
		"}";

	int ret;

	test_json_contents = json;
	test_dtb_contents = "dtb";
	test_dtb_name = "uni.dtb";
	test_image_name = "unikernel.bin";

	ret = xrun_run("/test", 0, "test");
	zassert_equal(ret, 0, "Error calling xrun_run");

	zassert_equal(g_cfg.mem_kb, 4096, "mem_kb wasn't decoded correctly");
	zassert_equal(g_cfg.max_vcpus, 1,
		      "max_vcpus wasn't decoded correctly");

	zassert_true(!strcmp(g_cfg.dtb_start, test_dtb_contents),
		     "Dtb file not decoded correctly");

	zassert_equal(g_cfg.cmdline, NULL, "Dtb file not decoded correctly");

	ret = xrun_kill("test");
	zassert_equal(ret, 0, "Error calling xrun_run");
}

ZTEST(lib_xrun_test, test_json_spec_no_dtb)
{
	char json[] = "{"
		"\"ociVersion\" : \"1.0.1\", "
		"\"vm\" : { "
		"\"hypervisor\": { "
		"\"path\": \"xen\", "
		"\"parameters\": [\"pvcalls=true\"] "
		"}, "
		"\"kernel\": { "
		"\"path\" : \"/lfs/unikernel.bin\", "
		"\"parameters\" : []"
		"}, "
		"\"hwConfig\": { "
		"\"deviceTree\": \"\", "
		"\"vcpus\": 1, "
		"\"memKB\": 4096, "
		"\"dtdevs\": [ \"dev1\", \"dev2\" ], "
		"\"iomems\": [ "
		"{ \"firstGFN\": 40000, "
		"\"firstMFN\": 40002, "
		"\"nrMFNs\": 1 }, "
		"{ \"firstGFN\": 50000, "
		"\"firstMFN\": 50002, "
		"\"nrMFNs\": 2 } "
		"], "
		"\"irqs\": [ 1, 2 ] "
		"} "
		"} "
		"}";

	int ret;

	test_json_contents = json;
	test_dtb_contents = "dtb";
	test_dtb_name = "uni.dtb";
	test_image_name = "unikernel.bin";

	ret = xrun_run("/test", 0, "test");
	zassert_equal(ret, 0, "Error calling xrun_run");

	zassert_equal(g_cfg.mem_kb, 4096, "mem_kb wasn't decoded correctly");
	zassert_equal(g_cfg.max_vcpus, 1, "max_vcpus wasn't decoded correctly");

	zassert_equal(g_cfg.dtb_start, NULL, "Dtb file not decoded correctly");

	zassert_equal(g_cfg.cmdline, NULL, "Dtb file not decoded correctly");

	ret = xrun_kill("test");
	zassert_equal(ret, 0, "Error calling xrun_run");
}

struct xrun_thread_info {
	int id_start;
	int id_end;
	k_tid_t tid;

};

static void xrun_starter(void *p1, void *p2, void *p3)
{
	struct xrun_thread_info *info = p1;
	int i, ret;
	char buf[25];

	for (i = info->id_start; i < info->id_end; i++) {
		snprintf(buf, 25, "test%d", i);
		ret = xrun_run("/test", 0, buf);
		zassert_equal(ret, 0, "Error calling xrun_run");
	}
}

static void xrun_stopper(void *p1, void *p2, void *p3)
{
	struct xrun_thread_info *info = p1;
	int i, ret;
	char buf[25];

	for (i = info->id_start; i < info->id_end; i++) {
		snprintf(buf, 25, "test%d", i);
		ret = xrun_kill(buf);
		zassert_equal(ret, 0, "Error calling xrun_run");
	}
}

#define STACK_SIZE (384)
#define THREADS_NUM 4

static struct xrun_thread_info tinfo[THREADS_NUM];
static struct k_thread tthread[THREADS_NUM];
static K_THREAD_STACK_ARRAY_DEFINE(tstack, THREADS_NUM, STACK_SIZE);

ZTEST(lib_xrun_test, test_start_stop_thread)
{
	char json[] = "{"
		"\"ociVersion\" : \"1.0.1\", "
		"\"vm\" : { "
		"\"hypervisor\": { "
		"\"path\": \"xen\", "
		"\"parameters\": [\"pvcalls=true\"] "
		"}, "
		"\"kernel\": { "
		"\"path\" : \"/lfs/unikernel.bin\", "
		"\"parameters\" : []"
		"}, "
		"\"hwConfig\": { "
		"\"deviceTree\": \"/lfs/uni.dtb\", "
		"\"vcpus\": 1, "
		"\"memKB\": 4096, "
		"\"dtdevs\": [ \"dev1\", \"dev2\" ], "
		"\"iomems\": [ "
		"{ \"firstGFN\": 40000, "
		"\"firstMFN\": 40002, "
		"\"nrMFNs\": 1 }, "
		"{ \"firstGFN\": 50000, "
		"\"firstMFN\": 50002, "
		"\"nrMFNs\": 2 } "
		"], "
		"\"irqs\": [ 1, 2 ] "
		"} "
		"} "
		"}";

	test_json_contents = json;
	test_dtb_contents = "dtb";
	test_dtb_name = "uni.dtb";
	test_image_name = "unikernel.bin";

	tinfo[0].id_start = 0;
	tinfo[0].id_end = 100;
	tinfo[0].tid = k_thread_create(&tthread[0], tstack[0], STACK_SIZE,
				       (k_thread_entry_t)xrun_starter,
				       &tinfo[0], NULL, NULL, K_PRIO_PREEMPT(5),
				       K_INHERIT_PERMS, K_NO_WAIT);
	tinfo[1].id_start = 100;
	tinfo[1].id_end = 200;
	tinfo[1].tid = k_thread_create(&tthread[1], tstack[1], STACK_SIZE,
				       (k_thread_entry_t)xrun_starter,
				       &tinfo[1], NULL, NULL, K_PRIO_PREEMPT(5),
				       K_INHERIT_PERMS, K_NO_WAIT);

	k_thread_join(tinfo[0].tid, K_FOREVER);
	tinfo[2].id_start = 0;
	tinfo[2].id_end = 100;
	tinfo[2].tid = k_thread_create(&tthread[2], tstack[2], STACK_SIZE,
				       (k_thread_entry_t)xrun_stopper,
				       &tinfo[2], NULL, NULL, K_PRIO_PREEMPT(5),
				       K_INHERIT_PERMS,
				       K_NO_WAIT);
	k_thread_join(tinfo[1].tid, K_FOREVER);
	tinfo[3].id_start = 100;
	tinfo[3].id_end = 200;
	tinfo[3].tid = k_thread_create(&tthread[3], tstack[3], STACK_SIZE,
				       (k_thread_entry_t)xrun_stopper,
				       &tinfo[3], NULL, NULL, K_PRIO_PREEMPT(5),
				       K_INHERIT_PERMS,
				       K_NO_WAIT);
	k_thread_join(tinfo[2].tid, K_FOREVER);
	k_thread_join(tinfo[3].tid, K_FOREVER);
}

ZTEST(lib_xrun_test, test_json_no_iomems)
{
	char json[] = "{"
		"\"ociVersion\" : \"1.0.1\", "
		"\"vm\" : { "
		"\"hypervisor\": { "
		"\"path\": \"xen\", "
		"\"parameters\": [\"pvcalls=true\"] "
		"}, "
		"\"kernel\": { "
		"\"path\" : \"/lfs/unikernel.bin\", "
		"\"parameters\" : [ \"port=8124\", \"hello world\" ]"
		"}, "
		"\"hwConfig\": { "
		"\"deviceTree\": \"/lfs/uni.dtb\", "
		"\"vcpus\": 2, "
		"\"memKB\": 4097, "
		"\"dtdevs\": [ \"dev1\", \"dev2\" ], "
		"\"iomems\": [ ], "
		"\"irqs\": [ 1, 2 ] "
		"} "
		"} "
		"}";

	int ret;

	test_json_contents = json;
	test_dtb_contents = "dtb";
	test_dtb_name = "uni.dtb";
	test_image_name = "unikernel.bin";

	ret = xrun_run("/test", 0, "test");
	zassert_equal(ret, 0, "Error calling xrun_run");

	zassert_equal(g_cfg.mem_kb, 4097, "mem_kb wasn't decoded correctly");
	zassert_equal(g_cfg.max_vcpus, 2, "max_vcpus wasn't decoded correctly");

	zassert_equal(g_cfg.nr_dtdevs, 2,
		      "dtdevs wasn't decoded correctly");

	zassert_true(!strcmp(g_cfg.dtdevs[0], "dev1"),
		     "Dtdevs not decoded correctly");
	zassert_true(!strcmp(g_cfg.dtdevs[1], "dev2"),
		     "Dtdevs not decoded correctly");

	zassert_equal(g_cfg.nr_irqs, 2,
		      "nr_irqs wasn't decoded correctly");
	zassert_equal(g_cfg.irqs[0], 1, "irqs wasn't decoded correctly");
	zassert_equal(g_cfg.irqs[1], 2, "irqs wasn't decoded correctly");

	zassert_equal(g_cfg.nr_iomems, 0,
		      "nr_iomems wasn't decoded correctly");
	zassert_equal(g_cfg.iomems, NULL,
		      "iomems wasn't decoded correctly");

	zassert_true(!strcmp(g_cfg.dtb_start, test_dtb_contents),
		     "Dtb file not decoded correctly");

	zassert_true(!strcmp(g_cfg.cmdline, "port=8124 hello world"),
		     "Dtb file not decoded correctly");

	ret = xrun_kill("test");
	zassert_equal(ret, 0, "Error calling xrun_run");
}

ZTEST(lib_xrun_test, test_json_no_dtdevs)
{
	char json[] = "{"
		"\"ociVersion\" : \"1.0.1\", "
		"\"vm\" : { "
		"\"hypervisor\": { "
		"\"path\": \"xen\", "
		"\"parameters\": [\"pvcalls=true\"] "
		"}, "
		"\"kernel\": { "
		"\"path\" : \"/lfs/unikernel.bin\", "
		"\"parameters\" : [ \"port=8124\", \"hello world\" ]"
		"}, "
		"\"hwConfig\": { "
		"\"deviceTree\": \"/lfs/uni.dtb\", "
		"\"vcpus\": 2, "
		"\"memKB\": 4097, "
		"\"dtdevs\": [ ], "
		"\"iomems\": [ ], "
		"\"irqs\": [ 1, 2 ] "
		"} "
		"} "
		"}";

	int ret;

	test_json_contents = json;
	test_dtb_contents = "dtb";
	test_dtb_name = "uni.dtb";
	test_image_name = "unikernel.bin";

	ret = xrun_run("/test", 0, "test");
	zassert_equal(ret, 0, "Error calling xrun_run");

	zassert_equal(g_cfg.mem_kb, 4097, "mem_kb wasn't decoded correctly");
	zassert_equal(g_cfg.max_vcpus, 2, "max_vcpus wasn't decoded correctly");

	zassert_equal(g_cfg.nr_dtdevs, 0, "dtdevs wasn't decoded correctly");

	zassert_equal(g_cfg.nr_irqs, 2, "nr_irqs wasn't decoded correctly");
	zassert_equal(g_cfg.irqs[0], 1, "irqs wasn't decoded correctly");
	zassert_equal(g_cfg.irqs[1], 2, "irqs wasn't decoded correctly");

	zassert_equal(g_cfg.nr_iomems, 0, "nr_iomems wasn't decoded correctly");
	zassert_equal(g_cfg.iomems, NULL, "iomems wasn't decoded correctly");

	zassert_true(!strcmp(g_cfg.dtb_start, test_dtb_contents),
		     "Dtb file not decoded correctly");
	zassert_true(!strcmp(g_cfg.cmdline, "port=8124 hello world"),
		     "Dtb file not decoded correctly");

	ret = xrun_kill("test");
	zassert_equal(ret, 0, "Error calling xrun_run");
}

ZTEST(lib_xrun_test, test_json_no_irqs)
{
	char json[] = "{"
		"\"ociVersion\" : \"1.0.1\", "
		"\"vm\" : { "
		"\"hypervisor\": { "
		"\"path\": \"xen\", "
		"\"parameters\": [\"pvcalls=true\"] "
		"}, "
		"\"kernel\": { "
		"\"path\" : \"/lfs/unikernel.bin\", "
		"\"parameters\" : [ \"port=8124\", \"hello world\" ]"
		"}, "
		"\"hwConfig\": { "
		"\"deviceTree\": \"/lfs/uni.dtb\", "
		"\"vcpus\": 2, "
		"\"memKB\": 4097, "
		"\"dtdevs\": [ ], "
		"\"iomems\": [ ], "
		"\"irqs\": [ ] "
		"} "
		"} "
		"}";

	int ret;

	test_json_contents = json;
	test_dtb_contents = "dtb";
	test_dtb_name = "uni.dtb";
	test_image_name = "unikernel.bin";

	ret = xrun_run("/test", 0, "test");
	zassert_equal(ret, 0, "Error calling xrun_run");

	zassert_equal(g_cfg.mem_kb, 4097, "mem_kb wasn't decoded correctly");
	zassert_equal(g_cfg.max_vcpus, 2, "max_vcpus wasn't decoded correctly");

	zassert_equal(g_cfg.nr_dtdevs, 0, "dtdevs wasn't decoded correctly");

	zassert_equal(g_cfg.nr_irqs, 0, "nr_irqs wasn't decoded correctly");

	zassert_equal(g_cfg.nr_iomems, 0, "nr_iomems wasn't decoded correctly");
	zassert_equal(g_cfg.iomems, NULL, "iomems wasn't decoded correctly");

	zassert_true(!strcmp(g_cfg.dtb_start, test_dtb_contents),
		     "Dtb file not decoded correctly");

	zassert_true(!strcmp(g_cfg.cmdline, "port=8124 hello world"),
		     "Dtb file not decoded correctly");

	ret = xrun_kill("test");
	zassert_equal(ret, 0, "Error calling xrun_run");
}

ZTEST(lib_xrun_test, test_json_no_vcpus)
{
	char json[] = "{"
		"\"ociVersion\" : \"1.0.1\", "
		"\"vm\" : { "
		"\"hypervisor\": { "
		"\"path\": \"xen\", "
		"\"parameters\": [\"pvcalls=true\"] "
		"}, "
		"\"kernel\": { "
		"\"path\" : \"/lfs/unikernel.bin\", "
		"\"parameters\" : [ \"port=8124\", \"hello world\" ]"
		"}, "
		"\"hwConfig\": { "
		"\"deviceTree\": \"/lfs/uni.dtb\", "
		"\"dtdevs\": [ ], "
		"\"iomems\": [ ], "
		"\"irqs\": [ ] "
		"} "
		"} "
		"}";

	int ret;

	test_json_contents = json;
	test_dtb_contents = "dtb";
	test_dtb_name = "uni.dtb";
	test_image_name = "unikernel.bin";

	ret = xrun_run("/test", 0, "test");
	zassert_equal(ret, 0, "Error calling xrun_run");

	zassert_equal(g_cfg.mem_kb, 4096,
		      "mem_kb wasn't decoded correctly val = %d",
		      g_cfg.mem_kb);
	zassert_equal(g_cfg.max_vcpus, 1,
		      "max_vcpus wasn't decoded correctly val = %d",
		      g_cfg.max_vcpus);

	zassert_equal(g_cfg.nr_dtdevs, 0, "dtdevs wasn't decoded correctly");

	zassert_equal(g_cfg.nr_irqs, 0, "nr_irqs wasn't decoded correctly");

	zassert_equal(g_cfg.nr_iomems, 0, "nr_iomems wasn't decoded correctly");
	zassert_equal(g_cfg.iomems, NULL, "iomems wasn't decoded correctly");

	zassert_true(!strcmp(g_cfg.dtb_start, test_dtb_contents),
		     "Dtb file not decoded correctly");

	zassert_true(!strcmp(g_cfg.cmdline, "port=8124 hello world"),
		     "Dtb file not decoded correctly");

	ret = xrun_kill("test");
	zassert_equal(ret, 0, "Error calling xrun_run");
}

ZTEST(lib_xrun_test, test_json_no_fields)
{
	char json[] = "{"
		"\"ociVersion\" : \"1.0.1\", "
		"\"vm\" : { "
		"\"hypervisor\": { "
		"\"path\": \"xen\", "
		"\"parameters\": [\"pvcalls=true\"] "
		"}, "
		"\"kernel\": { "
		"\"path\" : \"/lfs/unikernel.bin\", "
		"\"parameters\" : [ \"port=8124\", \"hello world\" ]"
		"}, "
		"\"hwConfig\": { "
		"\"deviceTree\": \"/lfs/uni.dtb\" "
		"} "
		"} "
		"}";

	int ret;

	test_json_contents = json;
	test_dtb_contents = "dtb";
	test_dtb_name = "uni.dtb";
	test_image_name = "unikernel.bin";

	ret = xrun_run("/test", 0, "test");
	zassert_equal(ret, 0, "Error calling xrun_run");

	zassert_equal(g_cfg.mem_kb, 4096,
		      "mem_kb wasn't decoded correctly val = %d",
		      g_cfg.mem_kb);
	zassert_equal(g_cfg.max_vcpus, 1,
		      "max_vcpus wasn't decoded correctly val = %d",
		      g_cfg.max_vcpus);

	zassert_equal(g_cfg.nr_dtdevs, 0, "dtdevs wasn't decoded correctly");

	zassert_equal(g_cfg.nr_irqs, 0, "nr_irqs wasn't decoded correctly");

	zassert_equal(g_cfg.nr_iomems, 0, "nr_iomems wasn't decoded correctly");
	zassert_equal(g_cfg.iomems, NULL, "iomems wasn't decoded correctly");

	zassert_true(!strcmp(g_cfg.dtb_start, test_dtb_contents),
		     "Dtb file not decoded correctly");

	zassert_true(!strcmp(g_cfg.cmdline, "port=8124 hello world"),
		     "Dtb file not decoded correctly");

	ret = xrun_kill("test");
	zassert_equal(ret, 0, "Error calling xrun_run");
}

ZTEST(lib_xrun_test, test_json_no_dtdevs_iomems)
{
	char json[] = "{"
		"\"ociVersion\" : \"1.0.1\", "
		"\"vm\" : { "
		"\"hypervisor\": { "
		"\"path\": \"xen\", "
		"\"parameters\": [\"pvcalls=true\"] "
		"}, "
		"\"kernel\": { "
		"\"path\" : \"/lfs/unikernel.bin\", "
		"\"parameters\" : [ \"port=8124\", \"hello world\" ]"
		"}, "
		"\"hwConfig\": { "
		"\"deviceTree\": \"/lfs/uni.dtb\", "
		"\"irqs\": [ ] "
		"} "
		"} "
		"}";

	int ret;

	test_json_contents = json;
	test_dtb_contents = "dtb";
	test_dtb_name = "uni.dtb";
	test_image_name = "unikernel.bin";

	ret = xrun_run("/test", 0, "test");
	zassert_equal(ret, 0, "Error calling xrun_run");

	zassert_equal(g_cfg.mem_kb, 4096,
		      "mem_kb wasn't decoded correctly val = %d",
		      g_cfg.mem_kb);
	zassert_equal(g_cfg.max_vcpus, 1,
		      "max_vcpus wasn't decoded correctly val = %d",
		      g_cfg.max_vcpus);

	zassert_equal(g_cfg.nr_dtdevs, 0, "dtdevs wasn't decoded correctly");

	zassert_equal(g_cfg.nr_irqs, 0, "nr_irqs wasn't decoded correctly");

	zassert_equal(g_cfg.nr_iomems, 0, "nr_iomems wasn't decoded correctly");
	zassert_equal(g_cfg.iomems, NULL, "iomems wasn't decoded correctly");

	zassert_true(!strcmp(g_cfg.dtb_start, test_dtb_contents),
		     "Dtb file not decoded correctly");

	zassert_true(!strcmp(g_cfg.cmdline, "port=8124 hello world"),
		     "Dtb file not decoded correctly");

	ret = xrun_kill("test");
	zassert_equal(ret, 0, "Error calling xrun_run");
}

ZTEST_SUITE(lib_xrun_test, NULL, NULL, NULL, NULL, NULL);
```

## include/domain.h
```c
/*
 * Copyright (c) 2023 EPAM Systems
 *
 * SPDX-License-Identifier: Apache-2.0
 */

#ifndef XENLIB_XEN_DOMAIN_H
#define XENLIB_XEN_DOMAIN_H

#include <stdint.h>
#include <sys/types.h>

/*
 * struct xen_arch_domainconfig's ABI is covered by
 * XEN_DOMCTL_INTERFACE_VERSION.
 */
#define XEN_DOMCTL_CONFIG_GIC_NATIVE   0
#define XEN_DOMCTL_CONFIG_GIC_V2       1
#define XEN_DOMCTL_CONFIG_GIC_V3       2

#define XEN_DOMCTL_CONFIG_TEE_NONE     0
#define XEN_DOMCTL_CONFIG_TEE_OPTEE    1

/* Is this an HVM guest (as opposed to a PV guest)? */
#define _XEN_DOMCTL_CDF_hvm           0
#define XEN_DOMCTL_CDF_hvm            (1U << _XEN_DOMCTL_CDF_hvm)

/* Use hardware-assisted paging if available? */
#define _XEN_DOMCTL_CDF_hap           1
#define XEN_DOMCTL_CDF_hap            (1U << _XEN_DOMCTL_CDF_hap)

#define CONTAINER_NAME_SIZE 64

struct xen_domain_iomem {
	/* where to map, if 0 - map to same place as mfn */
	uint64_t first_gfn;
	/* what to map */
	uint64_t first_mfn;
	/* how much frames to map */
	uint64_t nr_mfns;
};

/**
 * Function cb, that should load bufsize domain image bytes to given buffer
 * @param buf buffer, where bytes should be loaded
 * @param bufsize number of image bytes, that should be loaded
 * @param read_offset number of bytes, that should be skipped from image start
 * @param image_info private data, passed to callback
 * @return 0 on success, negative errno on error
 */
typedef int (*load_image_bytes_t)(uint8_t *buf, size_t bufsize,
				uint64_t read_offset, void *image_info);

/**
 * Function cb, that should return image size in bytes
 * @param image_info private data, that can be passed to cb
 * @param size output parameter, uint64_t pointer to result
 * @return 0 on success, negative errno on error
 */
typedef ssize_t (*get_image_size_t)(void *image_info, uint64_t *size);

struct pv_net_configuration {
};

struct pv_block_configuration {
};

#define MAX_PV_NET_DEVICES 3
#define MAX_PV_BLOCK_DEVICES 3

struct backend_configuration {
	struct pv_net_configuration vifs[MAX_PV_NET_DEVICES];
	struct pv_block_configuration disks[MAX_PV_BLOCK_DEVICES];
};

struct xen_domain_cfg {
	char name[CONTAINER_NAME_SIZE];
	uint64_t mem_kb;

	uint32_t flags;
	uint32_t max_vcpus;
	uint32_t max_evtchns;
	int32_t gnt_frames;
	int32_t max_maptrack_frames;

	/* ARM arch related */
	uint8_t gic_version;
	uint16_t tee_type;

	/* For peripheral sharing*/
	struct xen_domain_iomem *iomems;
	uint32_t nr_iomems;

	uint32_t *irqs;
	uint32_t nr_irqs;

	char **dtdevs;
	uint32_t nr_dtdevs;

	char **dt_passthrough;
	uint32_t nr_dt_passthrough;

	char *cmdline;

	const char *dtb_start, *dtb_end;

	load_image_bytes_t load_image_bytes;
	get_image_size_t get_image_size;

	void *image_info;
	struct backend_configuration back_cfg;
};

struct xen_domain_console {
};

struct xen_domain {
};

struct xen_domain *get_domain(uint32_t domid);
void put_domain(struct xen_domain *domain);

#endif /* XENLIB_XEN_DOMAIN_H */
```

## include/xen_dom_mgmt.h
```c
/*
 * Copyright (c) 2023 EPAM Systems
 *
 * SPDX-License-Identifier: Apache-2.0
 */

#ifndef XENLIB_XEN_DOM_MGMT_H
#define XENLIB_XEN_DOM_MGMT_H

#include <domain.h>

int domain_create(struct xen_domain_cfg *domcfg, uint32_t domid);
int domain_destroy(uint32_t domid);
int domain_pause(uint32_t domid);
int domain_unpause(uint32_t domid);
int domain_post_create(const struct xen_domain_cfg *domcfg, uint32_t domid);

#endif
```

## include/xl_parser.h
```c
/*
 * Copyright (c) 2023 EPAM Systems
 *
 * SPDX-License-Identifier: Apache-2.0
 */

#ifndef XL_PARSER_H
#define XL_PARSER_H

#include <domain.h>

/**
 * Function that takes one xl-like(see https://xenbits.xen.org/docs/unstable/man/xl.cfg.5.html Devices chapter)
 * and fill appropriate unconfigured parts inside cfg.
 * Note: currently supported configuration types are:
 *       disk https://xenbits.xen.org/docs/unstable/man/xl-disk-configuration.5.html
 *       vif  https://xenbits.xen.org/docs/unstable/man/xl-network-configuration.5.html
 * Examples:
 *  disk=['backend=1, vdev=xvda, access=rw, target=/dev/mmcblk0p3']
 *  vif =['backend=1,bridge=xenbr0,mac=08:00:27:ff:cb:ce,ip=172.44.0.2 255.255.255.0 172.44.0.1']
 *
 * Note: all internal configurations should obey key=value scheme.
 *
 * Restriction on disk type: only Xen virtual disk (aka xvd without partitions and in
 * lowercase) supported.
 * see : https://xenbits.xen.org/docs/unstable/man/xen-vbd-interface.7.html
 *
 * @param str xl like backend configuration string
 * @param cfg pointer to global backends configuration structure
 * @return 0 on success, negative errno on error
 */
int parse_one_record_and_fill_cfg(const char *str, struct backend_configuration *cfg);

#endif /* XL_PARSER_H */
```

## src/mock-parser.c
```c
/*
 * Copyright (C) 2024 EPAM Systems, Inc.
 *
 * SPDX-License-Identifier: Apache-2.0
 */

#include <xl_parser.h>

int parse_one_record_and_fill_cfg(const char *str, struct backend_configuration *cfg)
{
	return 0;
}
```

## src/mock-storage.c
```c
/*
 * Copyright (C) 2023 Renesas Electronics Corporation.
 * Copyright (C) 2023 EPAM Systems, Inc.
 *
 * SPDX-License-Identifier: Apache-2.0
 */

#include <errno.h>
#include <storage.h>
#include <string.h>

extern char *test_json_contents;
extern char *test_dtb_contents;

ssize_t xrun_read_file(const char *fpath, char *buf,
		       size_t size, int skip)
{
	if (strstr(fpath, "config.json")) {
		memcpy(buf, test_json_contents, strlen(test_json_contents));
		return strlen(test_json_contents) > size ?
			size : strlen(test_json_contents);
	}

	if (strstr(fpath, ".dtb")) {
		memcpy(buf, test_dtb_contents, strlen(test_dtb_contents));
		return strlen(test_dtb_contents) > size ?
			size : strlen(test_dtb_contents);
	}

	return -EINVAL;
}

ssize_t xrun_get_file_size(const char *fpath)
{

	if (strstr(fpath, "config.json")) {
		return strlen(test_json_contents);
	}

	if (strstr(fpath, ".dtb")) {
		return strlen(test_dtb_contents);
	}

	return -EINVAL;
}
```

## src/mock-xen-dom-mgmt.c
```c
/*
 * Copyright (c) 2023 EPAM Systems
 *
 * SPDX-License-Identifier: Apache-2.0
 */

#include <domain.h>
#include <string.h>

#include <zephyr/tc_util.h>
#include <zephyr/ztest.h>

#include <xen_dom_mgmt.h>
extern struct xen_domain_cfg g_cfg;

int domain_create(struct xen_domain_cfg *domcfg, uint32_t domid)
{
	memcpy(&g_cfg, domcfg, sizeof(*domcfg));
	return 0;
}

int domain_destroy(uint32_t domid)
{
	return 0;
}

int domain_pause(uint32_t domid)
{
	return 0;
}

int domain_unpause(uint32_t domid)
{
	return 0;
}

int domain_post_create(const struct xen_domain_cfg *domcfg, uint32_t domid)
{
	return 0;
}
```
