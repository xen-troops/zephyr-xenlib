## Kconfig
```kconfig
# Copyright (c) 2019 Peter Bigot Consulting, LLC
# SPDX-License-Identifier: Apache-2.0

mainmenu "Xen Libraries"

config XEN_STORE_SRV
	bool "Enable XenStore server"
	help
	  Enable xenstore server library. It should be included
	  if you are running Zephyr as Dom0.

config XEN_LIBFDT
	bool "Enable libfdt support"
	help
	  Enable libfdt module. This module allows you to generate
	  Domain device tree based on the parameters set in the
	  Domain config. It provides complete toolset to work with
	  flattened device tree.

config PARTIAL_DEVICE_TREE_SIZE
	int "Domain device tree size"
	default 8192
	depends on XEN_LIBFDT
	help
	  Maximum size of the domain device tree

config XEN_DOMAIN_MANAGEMENT
	bool "Enable Xen Domain Management"
	help
	  Enable domain management library. This library allows you
	  to create, destroy and manage xen domains.

config XEN_CONSOLE_SRV
	bool "Enable Xen Console server"
	help
	  Enable xen console server. It should be included if you
	  are running Zephyr as Dom0, otherwise any DomU that uses
	  Xen para-virtual console (PVC) may lock up. On other hand,
	  this server can be omitted if you are certain that DomUs
	  will never touch PV console.

config XEN_SHELL
	bool "Enable Xen shell commands"
	select SHELL
	help
	  Enable set of Xen shell commands for domain management.

config XENSTORE_SHELL_READ_SIZE
	int "Size of xs read buffer"
	default 256
	depends on XEN_SHELL
	help
	  Sets the maximum size that xs read cmd can handle

config XENSTORE_TREE_TRAVERSE_DEPTH
	int "Maximum xs traverse depth"
	default 8
	range 1 16
	depends on XEN_SHELL
	help
	  Sets the maximum xs traverse depth to avoid stack overflow
	  in case of deeply nested XS trees.

config XRUN_SHELL_CMDS
	bool "Enable XRUN shell commands"
	help
	  Enable set of XRUN shell commands to manage xrun library calls.

config XEN_VCH
	bool "Enable Xen vchannels support"
	help
	  Enable vchannel communication library.

config VCH_PATH_MAXLEN
	int "Maximum length of vchannel ID to read from XenStore"
	default 32
	help
	  The maximum XenStore path size that identify a separate vchannel.

config XRUN
	bool "Enable XRUN support"
	select JSON_LIBRARY
	help
	  Enable xrun support which allows to run domains based on the runtime spec.

config XRUN_JSON_SIZE_MAX
	int "Maximum size of the json cni spec"
	default 8192
	depends on XRUN
	help
	  Sets the maximum size of the cni spec json that could
	  be passed to xrun call.

config XRUN_MAX_PATH_SIZE
	int "Maximum length of file path to read from storage"
	default 255
	help
	  Sets the maximum path size that xrun can read from storage.
	  The default value is set to LFS_NAME_MAX which is default
	  for littlefs configuration.

config XRUN_DTDEVS_MAX
	int "Maximum numbers of the provided dtdevs"
	default 20
	help
	  Sets the maximum number of the dtdevs configuration
	  provided in the OCI spec.

config XRUN_IOMEMS_MAX
	int "Maximum numbers of the provided iomems"
	default 20
	help
	  Sets the maximum number of the iomems configuration
	  provided in the OCI spec.

config XRUN_IRQS_MAX
	int "Maximum numbers of the provided irqs"
	default 20
	help
	  Sets the maximum number of the irqs configuration
	  provided in the OCI spec.

config PFN_CHUNK_SIZE
	int "Chunk size for memory mapping operations"
	default 128
	help
	  Chunk size for helper functions for mapping/unmapping
	  memory from guest domain to Dom0.

config DOM_MAX
	int "Maximum number of DomU"
	default 4
	range 1 32
	help
	  Maximum number of DomU that can be created and launched.

config XSTAT
	bool "Enable XSTAT support"
	help
	  Enable xstat support which allows statistic information about running domains

config XSTAT_SHELL_CMDS
	depends on XSTAT
	depends on SHELL
	bool "Enable XSTAT shell commands"
	help
	  Enable set of XSTAT shell commands.

config XEN_DOM0LESS_BOOT
	bool "Xen dom0less boot support [EXPERIMENTAL]"
	help
	  Enable to support Xen dom0less boot. The domains started by Xen
	  will be identified and added to xenlib domain management subsystem, for each domain
	  xenstore will be initialized.

	  This is EXPERIMENTAL and depends on work in Xen mainline.
```

## tests/xrun/testcase.yaml
```yaml
tests:
  zephyr-xenlib.xrun:
    build_only: false
    tags: xrun
    integration_platforms:
      - native_posix_64
    platform_allow: native_posix_64
```

## xrun/Kconfig
```kconfig
# Copyright (c) 2024 EPAM Systems
# SPDX-License-Identifier: Apache-2.0

config XRUN
	bool "Enable XRUN support"
	select JSON_LIBRARY
	help
	  Enable xrun support which allows to run domains based on the runtime spec.

if XRUN

config XRUN_JSON_SIZE_MAX
	int "Maximum size of the json cni spec"
	default 8192
	help
	  Sets the maximum size of the cni spec json that could
	  be passed to xrun call.

config XRUN_MAX_PATH_SIZE
	int "Maximum length of file path to read from storage"
	default 255
	help
	  Sets the maximum path size that xrun can read from storage.
	  The default value is set to LFS_NAME_MAX which is default
	  for littlefs configuration.

config XRUN_DTDEVS_MAX
	int "Maximum numbers of the provided dtdevs"
	default 20
	help
	  Sets the maximum number of the dtdevs configuration
	  provided in the OCI spec.

config XRUN_IOMEMS_MAX
	int "Maximum numbers of the provided iomems"
	default 20
	help
	  Sets the maximum number of the iomems configuration
	  provided in the OCI spec.

config XRUN_IRQS_MAX
	int "Maximum numbers of the provided irqs"
	default 20
	help
	  Sets the maximum number of the irqs configuration
	  provided in the OCI spec.

config XRUN_STORAGE_DMA_DEBOUNCE
	int "Set debounce buffer for FS storage access in KB"
	default 0
	help
	  Sets debounce buffer for FS storage access in KB which is required to
	  enable DMA for storage devices. The xenlib may use DMA incompatible
	  buffers for reading guest domain kernel binaries using forging memory,
	  mapped in Dom0 address space. These buffers may not be contiguous and
	  phys/dma address can't be obtained for this buffers.
	  In such cases enables this option.

endif # XRUN
```
